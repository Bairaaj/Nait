/********************************************************************/
// HC12 Program:  Modulating a sine wave with PWM
// Processor:     MC9S12XDP512
// Bus Speed:     20 MHz
// Author:        Carlos Estay
// Details:       channel 7
//                                 
// Date:          March 21, 2023
// Revision History :
// Modified Nov 13, 2023


/********************************************************************/
// Constant Defines
/********************************************************************/

/********************************************************************/
#include <hidef.h>      /* common defines and macros */
#include "derivative.h" /* derivative-specific definitions */

#include <string.h>
#include <stdio.h>

#include "clock.h"
#include "rti.h"
#include "sw_led.h"
#include "segs.h"
#include "sci.h"


/********************************************************************/
// Library includes
/********************************************************************/
// your includes go here


/********************************************************************/
// Local Prototypes
/********************************************************************/
void RtiCallback(void);
/********************************************************************/
// Global Variables
/********************************************************************/
unsigned int msCounter = 0, duty = 100;
char update = 0;


/*Lookup Table - 256 sampled */
const unsigned char PWM256[] = { 102,104,107,109,112,114,117,119,121,124,126,129,131,133,136,138,	
                                140,142,145,147,149,151,153,155,157,159,161,163,165,167,169,170,
                                172,174,175,177,179,180,181,183,184,185,187,188,189,190,191,192,
                                193,194,195,195,196,197,197,198,198,198,199,199,199,199,199,199,
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                                66,	68,	70,	73,	75,	78,	80,	82,	85,	87,	90,	92,	95,	97,100,102,
};
unsigned int tableIndex = 0;
/********************************************************************/
// Constants
/********************************************************************/

/********************************************************************/
// Main Entry
/********************************************************************/
void main(void)
{
  // main entry point
  _DISABLE_COP();
  EnableInterrupts;
  
  /********************************************************************/
  // initializations
  /********************************************************************/
  Clock_Set20MHZ();
  SWL_Init();
  RTI_InitCallback(RtiCallback);

  //PWM configuration - channel 7
  //Working @20[MHz], 50[ns] ticks
  PWMPRCLK_PCKB0 = 0;
  PWMPRCLK_PCKB1 = 0;
  PWMPRCLK_PCKB2 = 0;

  //PWM positive polarity
  PWMPOL_PPOL7 = 1;  //PWM conf: High at the beginning of the period

  /*
  Clock to 20[MHz], no prescaling -> 50[ns] ticks
  200 ticks (period) = 200 x 50[ns] = 10[us] ->100[KHz]
  
  
  */

  //set period 1000 ticks = 50[us]
  PWMPER7 = 200;

  //set Duty cycle 50%
  PWMDTY7 = duty;
  
  PWME |= PWME_PWME7_MASK;  //Enable channel 7
  /********************************************************************/
  // main program loop
  /********************************************************************/
  for (;;)
  {
    PWMDTY7 = PWM256[tableIndex++];
    if(tableIndex > 255)
    {
      tableIndex = 0;
    }
  }
}

/********************************************************************/
// Functions
/********************************************************************/
void RtiCallback(void)
{
  if(++msCounter > 10)
  {
    msCounter = 0;
    update = 1;
  }
}
/********************************************************************/
// Interrupt Service Routines
/********************************************************************/