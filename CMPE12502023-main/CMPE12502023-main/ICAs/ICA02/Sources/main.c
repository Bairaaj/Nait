/********************************************************************/
// HC12 Program:  ICA-02 -migrate c# to c
// Processor:     MC9S12XDP512
// Bus Speed:     MHz
// Author:        Adrian Baira
// Details:       A more detailed explanation of the program is entered here               
// Date:          Sept 20, 2023
// Revision History :
// Sept 20, 2023 - added from 



/********************************************************************/
// Library includes
/********************************************************************/
#include <hidef.h>      /* common defines and macros */
#include "derivative.h" /* derivative-specific definitions */

//Other system includes or your includes go here
//#include <stdlib.h>
//#include <stdio.h>


/********************************************************************/
//Defines
/********************************************************************/

/********************************************************************/
// Local Prototypes
/********************************************************************/
void RED(int);
void GREEN(int);
/********************************************************************/
// Global Variables
/********************************************************************/
unsigned int uiMainLoopCount = 0;

/********************************************************************/
// Constants
/********************************************************************/

/********************************************************************/
// Main Entry
/********************************************************************/
void main(void)
{
  //Any main local variables must be declared here

  // main entry point
  _DISABLE_COP();
  //EnableInterrupts;
  
/********************************************************************/
  // one-time initializations
/********************************************************************/
PT1AD1 &= 0x1F;
DDR1AD1 = 0xE0;

/********************************************************************/
  // main program loop
/********************************************************************/

  for (;;)
  {
    ++uiMainLoopCount;
    RED(uiMainLoopCount < 0x1000);
    GREEN(uiMainLoopCount >= 0x1000);
  }                   
}

/********************************************************************/
// Functions
/********************************************************************/
void RED (Bool bOn)
{
  if (bOn)
   PT1AD1 |= (byte)(((int)1 << (7)));
   else
    {
      PT1AD1 &= 0x7F;
    }

}
void GREEN(Bool bOn)
{
  if (bOn)
    {
     PT1AD1 |= 0x20;
    }
    else
    {
      PT1AD1 &= 0b11011111;
    }
                            
        }

/********************************************************************/
// Interrupt Service Routines
/********************************************************************/
